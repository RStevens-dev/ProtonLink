## firmware/main/Kconfig.projbuild
```kconfig
menu "ProtonLink connection"
config PROTONLINK_WIFI_SSID
    string "Attenuator Wi-Fi SSID"
    default ""
config PROTONLINK_WIFI_PASSWORD
    string "Attenuator Wi-Fi password"
    default ""
config PROTONLINK_STATUS_URL
    string "Attenuator status URL"
    default "http://192.168.1.2/status"
endmenu
```

## firmware/sdkconfig.defaults
```kconfig
CONFIG_ESPTOOLPY_FLASHMODE_QIO=y
CONFIG_ESPTOOLPY_FLASHSIZE_16MB=y
CONFIG_SPIRAM=y
CONFIG_SPIRAM_MODE_OCT=y
CONFIG_SPIRAM_SPEED_80M=y
CONFIG_FREERTOS_HZ=1000
CONFIG_LV_OS_FREERTOS=y
CONFIG_LV_FONT_MONTSERRAT_24=y
CONFIG_LV_FONT_MONTSERRAT_12=y
CONFIG_LV_USE_COLOR_FILTER=y
CONFIG_SPIRAM_ALLOW_BSS_SEG_EXTERNAL_MEMORY=y
CONFIG_LV_USE_KEYBOARD=y
CONFIG_LV_USE_TEXTAREA=y
CONFIG_LV_FONT_MONTSERRAT_48=y
```
